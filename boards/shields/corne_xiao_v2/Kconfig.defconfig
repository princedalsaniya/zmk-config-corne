## boards/shields/corne_xiao_v2/Kconfig.defconfig
```kconfig
if SHIELD_CORNE_XIAO_V2_LEFT

config ZMK_KEYBOARD_NAME
    default "Corne"

config ZMK_SPLIT_BLE_CENTRAL_PERIPHERALS
    default 1

endif
```
